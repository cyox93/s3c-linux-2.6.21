## arch/arm/plat-wpu7800/Kconfig
```kconfig
# arch/arm/plat-wpu7800/Kconfig
#
# Copyright 2009 Unidata Communication
#
# Licensed under GPLv2

menu "WPU-7800 Platform"

config PLAT_WPU7800
	bool "WPU-7800 Platform"
	help
	  Say Y here if you are using an WPU-7800 platform
endmenu
```

## drivers/media/video/vc0528/Kconfig
```kconfig
config VIDEO_VC0528
	tristate "VC0528 Mobile Phone Video Processor"
	depends on VIDEO_V4L2 && MACH_CANOPUS
	default y
	---help---
	VC0528 camera driver for canopus
```

## drivers/regulator/wm8350/Kconfig
```kconfig
menu "Wolfson Microelectronics WM8350 PMIC"

config REGULATOR_WM8350
	bool

config PMIC_WM8350_MODE_0
	bool

config PMIC_WM8350_MODE_1
	bool

config PMIC_WM8350_MODE_2
	bool

config PMIC_WM8350_MODE_3
	bool

config PMIC_WM8351_MODE_0
	bool

config PMIC_WM8351_MODE_1
	bool

config PMIC_WM8351_MODE_2
	bool

config PMIC_WM8351_MODE_3
	bool


config S3C24XX_WM8350_PMU
	bool "WOLFSON WM8350 S3C24XX board PMU support"
	depends on REGULATOR
	select REGULATOR_WM8350
	select PMIC_WM8351_MODE_0
	---help---
	  If you say yes here you get support for the
	  Wolfon WM8350 PMIC chip on the Freescale S3C24XX.

	  This driver can also be built as a module. If so, the module
	  will be called imx32ads-wm8350.

config S3C24XX_WM8350_CHARDEV
	tristate "WM8350 device interface"
	depends on REGULATOR_WM8350
	help
	   Say Y here to us "wm8350" device files, found in ther /dev directory
	   on the system. They make it possible to have user-space progrms use
	   or control WM8350.

endmenu
```

## drivers/ucc/Kconfig
```kconfig
#
# UCC Modules configuration
#

menu "UDC Common Control Driver"

config UCC
	tristate "UCC support"
	default y
	---help---
	This is the remocon module driver. This module provides kernel API
	for the remocon.
	It controls also the IrDA interface.
	If you want Remocon support, you should say Y here

endmenu
```
